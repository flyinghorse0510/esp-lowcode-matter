## components/button/Kconfig
```kconfig
menu "BUTTON"
    choice BUTTON_DRIVER_GPIO_SETTINGS
        prompt "Select HP/LP gpio as button input"
        default BUTTON_DRIVER_USE_HP_GPIO

        config BUTTON_DRIVER_USE_HP_GPIO
        bool "Select HP GPIO as button input"

        config BUTTON_DRIVER_USE_LP_GPIO
        bool "Select LP GPIO as button input"
    endchoice
endmenu
```

## products/common/sdkconfig.defaults
```kconfig
# Enable LP Core
CONFIG_ULP_PANIC_OUTPUT_ENABLE=y
CONFIG_ULP_COPROC_ENABLED=y
CONFIG_ULP_COPROC_TYPE_LP_CORE=y
CONFIG_ULP_HP_UART_CONSOLE_PRINT=y

# AMP
CONFIG_ESP_AMP_ENABLED=y
CONFIG_ESP_AMP_SUBCORE_TYPE_LP_CORE=y

# LP Core Memory
CONFIG_ULP_COPROC_RESERVE_MEM=14500
CONFIG_ESPTOOLPY_FLASHSIZE_4MB=y

# HP Core Memory
CONFIG_ESP_AMP_SUBCORE_USE_HP_MEM=y
CONFIG_ESP_AMP_SUBCORE_USE_HP_MEM_SIZE=32768

# Memory Optimisation
CONFIG_COMPILER_OPTIMIZATION_SIZE=y

CONFIG_OPTIMIZATION_ASSERTIONS_SILENT=y
```
